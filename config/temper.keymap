#define CONFIG_WIRELESS
#define ZMK_BASE_LAYER(name, LT, RT, LM, RM, LB, RB, LH, RH)                   \
    ZMK_LAYER(                                                                 \
        name,                                                                  \
                 LT RT                                                         \
                 LM RM                                                         \
                 LB RB                                                         \
                 LH RH                                                         \
    )

#include "zmk-helpers/key-labels/36.h"
#include "base.dtsi"


// miryoku
//
// #include <dt-bindings/zmk/ext_power.h>
// #include "../miryoku/custom_config.h"
// #include "../miryoku/mapping/36/minidox.h"
// #include "../miryoku/miryoku.dtsi"
